## common_defconfig
```kconfig
BR2_ROOTFS_OVERLAY="../rootfs_overlay"
BR2_ROOTFS_POST_BUILD_SCRIPT="board/raspberrypi/post-build.sh ../board/post-build.sh"
BR2_LINUX_KERNEL_CONFIG_FRAGMENT_FILES="../board/linux.cfg"
BR2_PACKAGE_RPI_FIRMWARE_CONFIG_FILE="../board/config.txt"
BR2_PACKAGE_RPI_FIRMWARE_CMDLINE_FILE="../board/cmdline.txt"
BR2_PACKAGE_BCM2835=y
BR2_PACKAGE_CCPM=y
BR2_PACKAGE_8086TINY=y
BR2_PACKAGE_KEDEI62=y
BR2_PACKAGE_XT_GPIO=y
```

## external/Config.in
```kconfig
source "$BR2_EXTERNAL_project_base_PATH/package/ccpm/Config.in"
source "$BR2_EXTERNAL_project_base_PATH/package/8086tiny/Config.in"
#source "$BR2_EXTERNAL_project_base_PATH/package/kedei/Config.in"
```

## external/package/8086tiny/Config.in
```kconfig
config BR2_PACKAGE_8086TINY
	bool "8086tiny emulator"
	help
	  8086tiny emulator
```

## external/package/ccpm/Config.in
```kconfig
config BR2_PACKAGE_CCPM
	bool "CCP/M-86"
	help
	  Adds the CCP/M-86 image to the installation.
```

## external/package/kedei/Config.in
```kconfig
config BR2_PACKAGE_KEDEI
	bool "KeDei v6.2 driver"
	help
	  Display TFTLCD driver for Kedei v6.2
```

## external/package/xt_gpio/Config.in
```kconfig
config BR2_PACKAGE_XT_GPIO
	bool "xt_gpio"
	depends on BR2_LINUX_KERNEL
	help
	  GPIO-backed XT keyboard serio transport driver and DT overlay
	  for Raspberry Pi targets.
```
